## Config.in
```kconfig
# SPDX-License-Identifier: MPL-2.0-no-copyleft-exception

#XPONOS config
source "$BR2_EXTERNAL_XPONOS_PATH/package/mdev-static/Config.in"
source "$BR2_EXTERNAL_XPONOS_PATH/package/uboot-archive/Config.in"
source "$BR2_EXTERNAL_XPONOS_PATH/package/lantiq-ifxos/Config.in"
source "$BR2_EXTERNAL_XPONOS_PATH/package/lantiq-libcli/Config.in"
```

## configs/xponos_falcon_defconfig
```kconfig
BR2_mips=y
BR2_mips_32r2=y
BR2_TOOLCHAIN_EXTERNAL=y
BR2_TOOLCHAIN_EXTERNAL_CUSTOM=y
BR2_TOOLCHAIN_EXTERNAL_DOWNLOAD=y
BR2_TOOLCHAIN_EXTERNAL_URL="https://github.com/XPONos/prebuilt_toolchain/releases/download/mips-xponos-linux-uclibc_sdk-buildroot_2023.02/mips-xponos-linux-uclibc_sdk-buildroot_2023.02.tar.gz"
BR2_TOOLCHAIN_EXTERNAL_CUSTOM_PREFIX="mips-xponos-linux-uclibc"
BR2_TOOLCHAIN_EXTERNAL_HEADERS_3_10=y
# BR2_TOOLCHAIN_EXTERNAL_HAS_THREADS_DEBUG is not set
BR2_GLOBAL_PATCH_DIR="$(BR2_EXTERNAL_XPONOS_PATH)/board/falcon/patches"
BR2_TARGET_GENERIC_HOSTNAME="xponos-falcon"
BR2_TARGET_GENERIC_ISSUE="Welcome to XPONos"
BR2_ROOTFS_DEVICE_CREATION_STATIC=y
BR2_ROOTFS_STATIC_DEVICE_TABLE="$(BR2_EXTERNAL_XPONOS_PATH)/board/falcon/early_dev_table.txt"
BR2_ROOTFS_MERGED_USR=y
# BR2_TARGET_GENERIC_REMOUNT_ROOTFS_RW is not set
BR2_ROOTFS_OVERLAY="$(BR2_EXTERNAL_XPONOS_PATH)/board/falcon/rootfs $(BR2_EXTERNAL_XPONOS_PATH)/board/falcon/proprietary"
BR2_ROOTFS_POST_BUILD_SCRIPT="$(BR2_EXTERNAL_XPONOS_PATH)/board/falcon/post-build.sh"
BR2_PACKAGE_BUSYBOX_CONFIG_FRAGMENT_FILES="$(BR2_EXTERNAL_XPONOS_PATH)/board/falcon/busybox_addons.config"
BR2_PACKAGE_UBOOT_TOOLS=y
BR2_PACKAGE_UBUS=y
BR2_PACKAGE_LIBUCI=y
# BR2_PACKAGE_URANDOM_SCRIPTS is not set
BR2_TARGET_ROOTFS_SQUASHFS=y
# BR2_TARGET_ROOTFS_SQUASHFS_PAD is not set
BR2_TARGET_ROOTFS_SQUASHFS4_XZ=y
# BR2_TARGET_ROOTFS_TAR is not set
BR2_PACKAGE_MDEV_STATIC=y
BR2_PACKAGE_UBOOT_ARCHIVE=y
BR2_PACKAGE_LANTIQ_LIBCLI=y
```

## configs/xponos_falcon_sdk_defconfig
```kconfig
BR2_mips=y
BR2_mips_32r2=y
BR2_TOOLCHAIN_BUILDROOT_VENDOR="xponos"
BR2_TOOLCHAIN_BUILDROOT_UCLIBC=y
BR2_KERNEL_HEADERS_VERSION=y
BR2_DEFAULT_KERNEL_VERSION="3.10.108"
BR2_PACKAGE_HOST_LINUX_HEADERS_CUSTOM_3_10=y
BR2_BINUTILS_VERSION_2_39_X=y
BR2_GCC_VERSION_12_X=y
BR2_CCACHE=y
BR2_CCACHE_DIR="$(BR2_EXTERNAL_XPONOS_PATH)/.ccache"
BR2_INIT_NONE=y
BR2_SYSTEM_BIN_SH_NONE=y
# BR2_PACKAGE_BUSYBOX is not set
# BR2_TARGET_ROOTFS_TAR is not set
```

## package/lantiq-ifxos/Config.in
```kconfig
# SPDX-License-Identifier: MPL-2.0-no-copyleft-exception

config BR2_PACKAGE_LANTIQ_IFXOS
    bool "Lantiq IFXOS abstraction layer"
    
if BR2_PACKAGE_LANTIQ_IFXOS    
    
config BR2_PACKAGE_LANTIQ_IFXOS_SHARED_LIB
    bool "Enable IFXOS build as shared lib"
    default n
    
endif
```

## package/lantiq-libcli/Config.in
```kconfig
# SPDX-License-Identifier: MPL-2.0-no-copyleft-exception

config BR2_PACKAGE_LANTIQ_LIBCLI
    bool "Lantiq common CLI library"
    
if BR2_PACKAGE_LANTIQ_LIBCLI   

config BR2_PACKAGE_LANTIQ_LIBCLI_CONSOLE
    bool "Add console interface support"
    default y
    
config BR2_PACKAGE_LANTIQ_LIBCLI_PIPE
    bool "Add pipe interface support"
    default y
    
config BR2_PACKAGE_LANTIQ_LIBCLI_MAX_PIPE
    int "Max pipes number (default 3)"
    depends on BR2_PACKAGE_LANTIQ_LIBCLI_PIPE
    default 3
    
config BR2_PACKAGE_LANTIQ_LIBCLI_BUFFER_OUT
    bool "Enable if the user CLI functions are using a mem buffer for printout"
    default n
    
config BR2_PACKAGE_LANTIQ_LIBCLI_FILE_OUT
    bool "Enable if the user CLI functions are using a file fd for printout"
    default y 
    
config BR2_PACKAGE_LANTIQ_LIBCLI_ERROR
    bool "Enable error output"
    default y  
    
config BR2_PACKAGE_LANTIQ_LIBCLI_DEBUG
    bool "Enable verbose debug output"
    default y 
    
endif
```

## package/mdev-static/Config.in
```kconfig
config BR2_PACKAGE_MDEV_STATIC
    bool "Busybox mdev static"
    depends on BR2_INIT_BUSYBOX
    depends on BR2_ROOTFS_DEVICE_CREATION_STATIC
    help
        Allows you to populate /dev without requiring devtmpfs support.
```

## package/uboot-archive/Config.in
```kconfig
# SPDX-License-Identifier: MPL-2.0-no-copyleft-exception

config BR2_PACKAGE_UBOOT_ARCHIVE
    bool "uboot-archive"
    depends on BR2_PACKAGE_UBOOT_TOOLS
    help
        Archive files and directories in U-Boot-env.
```
